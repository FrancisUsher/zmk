## app/boards/arm/tb42/Kconfig.board
```kconfig
# Tiny Blue 42 (TB42) board configuration

# Copyright (c) 2020 Francis Usher
# SPDX-License-Identifier: MIT

config BOARD_TB42
	bool "tb42"
	depends on SOC_NRF52840_QIAA
```

## app/boards/arm/tb42/Kconfig.defconfig
```kconfig
# Copyright (c) 2020 Francis Usher
# SPDX-License-Identifier: MIT

if BOARD_TB42

config BOARD
	default "tb42"

if USB

config USB_NRFX
	default y

config USB_DEVICE_STACK
	default y

endif # USB

config BT_CTLR
	default BT

config ZMK_BLE
	default y

config ZMK_USB
	default y

endif # BOARD_TB42
```
